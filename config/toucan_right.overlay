/*
 * User customization: Azoteq TPS43 trackpad power management & responsiveness tuning
 *
 * Extends timeout before deep LP2 sleep to keep the trackpad responsive during active typing sessions,
 * and lowers LP2 scan rate from 640ms to 160ms for fast wake-up.
 */

&tps43_trackpad {
    timeout-lp1 = <9>;       /* 180s (3 min) timeout before entering LP2 state (default was 20s) */
    report-rate-lp1 = <40>;  /* 40ms report rate while in LP1 */
    report-rate-lp2 = <160>; /* 160ms report rate in LP2 state (down from sluggish 640ms) */
};
